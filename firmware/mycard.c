#include "ch32v003fun.h"
#include <stdio.h>
#include "ws2812b_dma_spi_led_driver.h"


uint32_t count;
uint16_t lastnum=123;


uint8_t letters[128][6] = {
{0x00,0x00,0x00,0x00,0x00,0x00},   //   0x 0 0
{0x00,0x64,0x18,0x04,0x64,0x18},   //  0x 1 1 Left arrow
{0x00,0x3c,0x40,0x40,0x20,0x7c},   //  0x 2 2
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{0x00,0x7f,0x6b,0x6b,0x6b,0x7f}    //  0x7f 127};
};
void showchar(uint8_t);



/* some bit definitions for systick regs */
#define SYSTICK_SR_CNTIF (1<<0)
#define SYSTICK_CTLR_STE (1<<0)
#define SYSTICK_CTLR_STIE (1<<1)
#define SYSTICK_CTLR_STCLK (1<<2)
#define SYSTICK_CTLR_STRE (1<<3)
#define SYSTICK_CTLR_SWIE (1<<31)


volatile uint32_t systick_cnt;
volatile uint32_t cnts[40];
volatile uint16_t cmd=0;
volatile uint8_t bits=0, switch_wake=0;





// From https://github.com/Blakesands/CH32V003/blob/main/GD_WS2812_DRIVER.h
// Send a single bit using the GD pinwiggle protocol.
void LED_SendBit(uint8_t bit)
{
    if (bit) {
    //// Send a 1 bit
        GPIOD->BSHR |= 1 << 6; // put pin D6 high and wait for 800nS
            __asm__("nop");__asm__("nop");__asm__("nop");__asm__("nop");
            __asm__("nop");__asm__("nop");__asm__("nop");__asm__("nop");
            __asm__("nop");__asm__("nop");__asm__("nop");__asm__("nop");
            __asm__("nop");__asm__("nop");__asm__("nop");__asm__("nop");
            __asm__("nop");__asm__("nop");__asm__("nop");__asm__("nop");
            __asm__("nop");__asm__("nop");__asm__("nop");__asm__("nop");
            __asm__("nop");__asm__("nop");__asm__("nop");__asm__("nop");
            __asm__("nop");__asm__("nop");__asm__("nop");__asm__("nop");
            __asm__("nop");__asm__("nop");
        GPIOD->BCR = 1 << 6; // put pin D6 low and exit, 400nS is taken up by other functions
        return;
        }
//    else {
        // Send a 0 bit
        GPIOD->BSHR |= 1 << 6; // put pin D6 high and wait for 400nS
            __asm__("nop");__asm__("nop");__asm__("nop");__asm__("nop");
            __asm__("nop");__asm__("nop");__asm__("nop");__asm__("nop");
            __asm__("nop");__asm__("nop");__asm__("nop");__asm__("nop");
            __asm__("nop");__asm__("nop");
        GPIOD->BCR |= 1 << 6; // put pin D6 low and wait for 400nS, 400nS is taken up by other functions
            __asm__("nop");__asm__("nop");__asm__("nop");__asm__("nop");
            __asm__("nop");__asm__("nop");__asm__("nop");__asm__("nop");
            __asm__("nop");__asm__("nop");__asm__("nop");__asm__("nop");
            __asm__("nop");__asm__("nop");__asm__("nop");__asm__("nop");
            __asm__("nop");__asm__("nop");__asm__("nop");__asm__("nop");
//    }
}

// Send a single colour for a single LED
//WS2812B LEDs want 24 bits per led in the string
void LED_SendColour(uint8_t red, uint8_t green, uint8_t blue)
{
    // Send the green component first (MSB)
    for (int i = 7; i >= 0; i--) {
        LED_SendBit((green >> i) & 1);
    }
    // Send the red component next
    for (int i = 7; i >= 0; i--) {
        LED_SendBit((red >> i) & 1);
    }
    // Send the blue component last (LSB)
    for (int i = 7; i >= 0; i--) {
        LED_SendBit((blue >> i) & 1);
    }
}


void blink(){
	for(int i=0;i<2;i++){
	    GPIOC->BSHR |= 0b11111111; // set all
		Delay_Ms(500);
	    GPIOC->BCR |= 0b11111111; // clear all
		Delay_Ms(500);
	}
}

void blinkbit(uint8_t bit){
	for(int i=0;i<2;i++){
	    GPIOC->BCR |= 255; // clear all
		Delay_Ms(200);
	    GPIOC->BSHR |= 1<<bit; // set all
		Delay_Ms(200);
	}
}

void section1(){
			GPIOD->BCR |= 0b1100; GPIOD->BSHR |= 0b1000;
}
void section2(){
			GPIOD->BCR |= 0b1100; GPIOD->BSHR |= 0b0100;
}
void sectionoff(){
			GPIOC->BCR |= 0b11111111; // clear all L1-L7 as well
			GPIOD->BCR |= 0b1100;
}



void adc_init( void );
uint16_t adc_get( void );

void enableAutoWakeup();
void writeString(char * s);
void fadeRGB();

void scrollUpDown(uint8_t);
void fadeAutoRGB();

void batmon(){
	section1();
	GPIOC->BCR = 0b11111111; // clear all
	GPIOC->BSHR |= (1<<((2*adc_get()-6600)/150))-1 ; // set new
	//printf("%d\n",(2*adc_get())/1000);
	Delay_Ms(1000);
	section2();
	Delay_Ms(200);
	sectionoff();
}
void fadeheart(uint8_t times){
	sectionoff();
	// Enable GPIOC, GPIOD and TIM1
	RCC->APB2PCENR |= 	RCC_APB2Periph_TIM1;
	
	// Reset TIM1 to init all regs
	RCC->APB2PRSTR |= RCC_APB2Periph_TIM1;
	RCC->APB2PRSTR &= ~RCC_APB2Periph_TIM1;
	
	// CTLR1: default is up, events generated, edge align
	// SMCFGR: default clk input is CK_INT
	
	// Prescaler 
	TIM1->PSC = 0x0000;	
	// Auto Reload - sets period
	TIM1->ATRLR = 255;	
	// Reload immediately
	TIM1->SWEVGR |= TIM_UG;
	

	TIM1->CTLR1 |= TIM_ARPE;

	// Enable CH1 output, positive pol
	TIM1->CCER |= TIM_CC1E;
	
	// CH1 Mode is output, PWM1 (CC1S = 00, OC1M = 110)
	TIM1->CHCTLR1 |= TIM_OC1M_2 | TIM_OC1M_1 | TIM_OC1PE;
	// Set the Capture Compare Register value to 50% initially
	TIM1->CH1CVR = 1;
	// Enable TIM1 outputs
	TIM1->BDTR |= TIM_MOE;
	// Enable TIM1
	TIM1->CTLR1 |= TIM_CEN;
	funPinMode( PD2, GPIO_CFGLR_OUT_10Mhz_AF_PP );	//enable alt func
	GPIOC->BSHR |= 0b11100 ; // set new
	for(int n=0;n<times;n++){
		for(int x=1;x<255;x++){
			TIM1->CH1CVR = x;
			Delay_Ms(50);
		}
		for(int x=255;x>0;x--){
			TIM1->CH1CVR = x;
			Delay_Ms(50);
		}
	}
	// Stop TIM1
	TIM1->CTLR1 &= ~TIM_CEN;
	funPinMode( PD2, GPIO_CFGLR_OUT_10Mhz_PP );	//back to push pull
}



void EXTI7_0_IRQHandler( void ) __attribute__((interrupt));
void EXTI7_0_IRQHandler( void ) 
{
	for(int z=0;z<2;z++){
		scrollUpDown(2);
		scrollUpDown(1);
	}
	
	//fadeAutoRGB();						
	for(int z=0;z<10;z++){
		TIM2->CNT = 0;
		writeString("HELLO");
	}			
	sectionoff();
	//fadeRGB();

	EXTI->INTFR = EXTI_Line0;
}

int main()
{
	uint8_t wakeups=0;
	SystemInit();

	SetupDebugPrintf();
	SysTick->CTLR = 0;
	SysTick->CNT = 0;
	/* Enable SysTick counter, IRQ, HCLK/1 */
	SysTick->CTLR = SYSTICK_CTLR_STE | SYSTICK_CTLR_STIE |
					SYSTICK_CTLR_STCLK;
	// Enable GPIOs
	RCC->APB2PCENR = RCC_APB2Periph_GPIOD | RCC_APB2Periph_GPIOC | RCC_APB2Periph_AFIO;

	
	// Enable TIM2
	RCC->APB1PCENR |= RCC_APB1Periph_TIM2;
	// Reset TIM2 to init all regs
	RCC->APB1PRSTR |= RCC_APB1Periph_TIM2;
	RCC->APB1PRSTR &= ~RCC_APB1Periph_TIM2;
	// SMCFGR: default clk input is CK_INT
	// set TIM2 clock prescaler divider 
	TIM2->PSC = 0xFFFF;
	// Enable TIM2
	TIM2->CTLR1 |= TIM_CEN;
	

	// GPIO D3,D4 for input pin change.
	//funPinMode( PD3, GPIO_CFGLR_IN_FLOAT );
	funPinMode( PD4, GPIO_CFGLR_IN_FLOAT );

	funPinMode( PD0,  GPIO_CFGLR_IN_PUPD ); //switch

	funDigitalWrite( PA2, FUN_HIGH );
	funDigitalWrite( PD0, FUN_HIGH );

	//funPinMode( PD6,  GPIO_CFGLR_OUT_10Mhz_PP ); //rgb

	funPinMode( PC0,  GPIO_CFGLR_OUT_10Mhz_PP );
	funPinMode( PC1,  GPIO_CFGLR_OUT_10Mhz_PP );
	funPinMode( PC2,  GPIO_CFGLR_OUT_10Mhz_PP );
	funPinMode( PC3,  GPIO_CFGLR_OUT_10Mhz_PP );
	funPinMode( PC4,  GPIO_CFGLR_OUT_10Mhz_PP );
	funPinMode( PC5,  GPIO_CFGLR_OUT_10Mhz_PP );
	funPinMode( PC6,  GPIO_CFGLR_OUT_10Mhz_PP );
	funPinMode( PC7,  GPIO_CFGLR_OUT_10Mhz_PP );

	// OUTPUT TRANSISTORS
	funPinMode( PD2, GPIO_CFGLR_OUT_10Mhz_PP );	
	funPinMode( PD3, GPIO_CFGLR_OUT_10Mhz_PP );	
	funDigitalWrite( PD2, FUN_LOW );
	funDigitalWrite( PD3, FUN_LOW );



	asm volatile(
#if __GNUC__ > 10
		".option arch, +zicsr\n"
#endif
 		"addi t1, x0, 3\n"
		"csrrw x0, 0x804, t1\n"
		 : : :  "t1" );

	// Configure the D0 IO as an interrupt.
	AFIO->EXTICR = AFIO_EXTICR_EXTI0_PD;
	EXTI->INTENR = EXTI_INTENR_MR0; // Enable EXT3
	EXTI->RTENR = EXTI_FTENR_TR0;  // Falling edge trigger
	// enable interrupt
	NVIC_EnableIRQ( EXTI7_0_IRQn );
	//NVIC_DisableIRQ(EXTI7_0_IRQn);

	// select standby on power-down
	PWR->CTLR |= PWR_CTLR_PDDS;


	funPinMode( PD5,  GPIO_CFGLR_IN_PUPD ); //REED switch
	funDigitalWrite(PD5, FUN_HIGH); //pullup reed switch


	enableAutoWakeup();
	
	//adc_init(); //vdd monitoring
	while(1){

		if (wakeups%5==0)
			fadeheart(1);

		wakeups++;
		//batmon();

		NVIC_EnableIRQ( EXTI7_0_IRQn );
		// peripheral interrupt controller send to deep sleep
		sectionoff();
		PFIC->SCTLR |= (1 << 2);
		//printf("entering sleep loop \n");
		switch_wake=0; // reset switch wake flag.
		__WFE();
		//printf("\nALIVEEE\n");
		SystemInit();
		NVIC_DisableIRQ(EXTI7_0_IRQn);

	}


}


void adc_init( void )
{
	// ADCCLK = 24 MHz => RCC_ADCPRE = 0: divide by 2
	RCC->CFGR0 &= ~(0x1F<<11);
	
	// Enable  ADC
	RCC->APB2PCENR |=  RCC_APB2Periph_ADC1;
	
	// Reset the ADC to init all regs
	RCC->APB2PRSTR |= RCC_APB2Periph_ADC1;
	RCC->APB2PRSTR &= ~RCC_APB2Periph_ADC1;
	
	// Set up single conversion on chl 5(Vdd)
	ADC1->RSQR1 = 0;
	ADC1->RSQR2 = 0;
	ADC1->RSQR3 = 8;	// 0-9 for 8 ext inputs and two internals
	
	// set sampling time for chl 7
	ADC1->SAMPTR2 &= ~(ADC_SMP0<<(3*7));
	ADC1->SAMPTR2 |= 7<<(3*7);	// 0:7 => 3/9/15/30/43/57/73/241 cycles
		
	// turn on ADC and set rule group to sw trig
	ADC1->CTLR2 |= ADC_ADON | ADC_EXTSEL;
	
	// Reset calibration
	ADC1->CTLR2 |= ADC_RSTCAL;
	while(ADC1->CTLR2 & ADC_RSTCAL);
	
	// Calibrate
	ADC1->CTLR2 |= ADC_CAL;
	while(ADC1->CTLR2 & ADC_CAL);
	
	// should be ready for SW conversion now
}

/*
 * start conversion, wait and return result
 */
uint16_t adc_get( void )
{
	// start sw conversion (auto clears)
	ADC1->CTLR2 |= ADC_SWSTART;
	// wait for conversion complete
	while(!(ADC1->STATR & ADC_EOC));
	
	// get result
	return ((uint32_t)1200 * 1023 / ADC1->RDATAR); //return in mV
}


void enableAutoWakeup(){
	// enable power interface module clock
	RCC->APB1PCENR |= RCC_APB1Periph_PWR;

	// enable low speed oscillator (LSI)
	RCC->RSTSCKR |= RCC_LSION;
	while ((RCC->RSTSCKR & RCC_LSIRDY) == 0) {}

	// enable AutoWakeUp event
	EXTI->EVENR |= EXTI_Line9;
	EXTI->FTENR |= EXTI_Line9;

	// configure AWU prescaler
	PWR->AWUPSC |= PWR_AWU_Prescaler_61440;

	// configure AWU window comparison value
	PWR->AWUWR &= ~0x3f;
	PWR->AWUWR |= 63;

	// enable AWU
	PWR->AWUCSR |= (1 << 1);

}

void fadeRGB(){
	return;
		for(int y=0;y<2;y++){

			for(int x=0;x<100;x++){
				LED_SendColour(x,100-x,x);
				Delay_Ms(30);
			}
			for(int x=100;x>0;x--){
				LED_SendColour(x,100-x,x);
				Delay_Ms(30);
			}
		}
		for(int x=100;x>=0;x--){
			LED_SendColour(0,x,0);
			Delay_Ms(50);
		}

}

unsigned char reverse(unsigned char b) {
   b = (b & 0xF0) >> 4 | (b & 0x0F) << 4;
   b = (b & 0xCC) >> 2 | (b & 0x33) << 2;
   b = (b & 0xAA) >> 1 | (b & 0x55) << 1;
   return b;
}

#define POV_DEL 12
void showchar(uint8_t c){
  uint8_t x;
  for(x=0;x<6;x++)
   {
    GPIOC->BCR = 0b11111111; // clear all
    GPIOC->BSHR |= reverse( (letters[c][x]<<1)&0xFF) ; // set new
    Delay_Ms(POV_DEL);
   }
    GPIOC->BCR = 0b11111111; // clear all
}

void writeString(char * s){
	while( (((GPIOD->INDR)>>5)&1) && TIM2->CNT<1000 ); // no contact. high
	while( !(((GPIOD->INDR)>>5)&1) && TIM2->CNT<1000 ); //contact. low
	while( (((GPIOD->INDR)>>5)&1) && TIM2->CNT<1000 ); // no contact. high
    Delay_Ms(POV_DEL*2);
	GPIOD->BCR |= 0b1100; GPIOD->BSHR |= 0b1000;
	while(*s != '\0'){
		showchar(*s);
		s++;
	}
}


void scrollUpDown(uint8_t section){
		if(section==1)
			section1();
		else 
			section2();


		for(int x=0;x<8;x++)
		{
			GPIOC->BCR |= 0b11111111; // clear all
			GPIOC->BSHR |= (1<<x); // set new
			Delay_Ms(200);
		}
		for(int x=8;x>0;x--)
		{
			GPIOC->BCR |= 0b11111111; // clear all
			GPIOC->BSHR |= (1<<(x-1)); // set new
			Delay_Ms(200);
		}
		sectionoff();
}

void fadeAutoRGB(){
	section2();
	GPIOC->BSHR |= 128+1; // set new
	Delay_Ms(40000);
	sectionoff();
}
